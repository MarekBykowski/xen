## xen/arch/arm/configs/agilex_debug_defconfig
```kconfig
CONFIG_NR_CPUS=4
CONFIG_AGILEX=y
CONFIG_EXPERT=y
# CONFIG_UNSUPPORTED is not set
CONFIG_DEBUG=y
CONFIG_DEVICE_TREE_DEBUG=y
```

## xen/drivers/misc/Kconfig
```kconfig
config MEMORY_SPAN_EXTENDER
	bool "Memory Span Extender driver" if AGILEX
	default n
	help
	  This selects the Memory Span Extender. If unsure select N.
```
